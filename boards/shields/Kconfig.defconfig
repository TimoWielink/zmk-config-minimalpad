## boards/shields/Kconfig.defconfig
```kconfig
# Default configuration for minimalpad

if SHIELD_MINIMALPAD

# Name of the keyboard
config ZMK_KEYBOARD_NAME
    default "MinimalPad"

endif
```

## boards/shields/minimalpad/Kconfig.defconfig
```kconfig
# Default configuration for minimalpad

if SHIELD_MINIMALPAD

# Name of the keyboard
config ZMK_KEYBOARD_NAME
    default "minimalpad"

# Enable ZMK's Bluetooth
config ZMK_BLE
    default y

endif
```

## boards/shields/minimalpad/Kconfig.shield
```kconfig
# Kconfig.shield for minimalpad

config SHIELD_MINIMALPAD
    def_bool $(shields_list_contains,minimalpad)
```
