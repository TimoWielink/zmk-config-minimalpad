## Kconfig
```kconfig
# Minimalpad firmware additions: the host module, a corrected ZMK Studio Bluetooth
# transport, and the underglow's idle fade
# SPDX-License-Identifier: MIT

menuconfig MINIMALPAD_HOST
    bool "Minimalpad host module"
    depends on ZMK_BLE
    default y
    help
      The device channel Minimalpad Studio uses for what ZMK Studio RPC cannot
      do: switching the pad to a profile layer, setting the underglow colour,
      and the heartbeat that returns the pad to Default when Studio goes away.
      It runs over its own GATT service on Bluetooth and shares ZMK Studio's
      CDC-ACM stream on USB. The wire format is
      docs/protocol/host-protocol.md in minimalpad-studio-mac, and
      include/minimalpad/mp_host_protocol.h here is a verbatim copy of its
      C header.

if MINIMALPAD_HOST

DT_CHOSEN_ZMK_STUDIO_RPC_UART := zmk,studio-rpc-uart

config MINIMALPAD_HOST_USB
    bool "Carry the host protocol beside ZMK Studio on USB"
    depends on ZMK_STUDIO_RPC
    select SERIAL
    select RING_BUFFER
    default y if $(dt_chosen_enabled,$(DT_CHOSEN_ZMK_STUDIO_RPC_UART))
    help
      Multiplexes host-protocol frames and ZMK Studio RPC frames on the one
      CDC-ACM port selected by the studio-rpc-usb-uart snippet. Using one port
      makes the identity Studio verifies and every Profile write belong to the
      same physical pad. Disable ZMK's stock UART Studio transport when this is
      enabled; this module replaces it with the combined transport.

config MINIMALPAD_HOST_USB_TX_BUFFER_SIZE
    int "Combined USB transmit buffer size"
    depends on MINIMALPAD_HOST_USB
    range 128 2048
    default 512
    help
      Holds complete host frames and chunks of a Studio RPC response while the
      CDC-ACM endpoint drains. Producers wait briefly rather than dropping a
      frame when this buffer fills.

config MINIMALPAD_HOST_HEARTBEAT_DEFAULT_TIMEOUT
    int "Fallback window, in seconds, before the host's first HEARTBEAT"
    range 1 255
    default 6
    help
      host-protocol.md has Studio send HEARTBEAT every 2 seconds with a 6
      second window, and each HEARTBEAT sets the window from then on. Until
      the first one arrives, SET_PROFILE, SWITCH_PROFILE and SET_LEDS arm the
      fallback with this window, so a host that stops between switching and
      its first heartbeat still cannot leave the pad on a profile (ADR 0005).

config MINIMALPAD_PROFILE_LAYERS
    bool "Several layers for one profile, switched on the pad"
    default y
    help
      Profile layers, feature bit 0 of FEATURES. With each app switch Studio
      sends SWITCH_PROFILE: the layer to show and the profile's layers, its
      group, which the pad keeps in RAM, never saved, while Studio holds it.
      The &profile_layer key then moves within the group on the pad itself,
      Next layer, Go to and Hold for, with no round trip to the Mac, and
      STATE's change byte tells Studio when a key moved the layer. Without
      this, SWITCH_PROFILE is skipped as an unknown command and Studio
      switches with SET_PROFILE.

config MINIMALPAD_PROFILE_LAYER_BEHAVIOR
    bool "The &profile_layer key: Next layer, Go to and Hold for"
    depends on MINIMALPAD_PROFILE_LAYERS && DT_HAS_MINIMALPAD_BEHAVIOR_PROFILE_LAYER_ENABLED
    default y
    help
      A key bound to &profile_layer moves between the layers of the profile
      Studio holds the pad on: PL_NEXT 0 swaps to the next layer, wrapping
      round, PL_GO layer swaps to that layer, and PL_HOLD layer swaps to it,
      or to Default, until the key is released. The layer id is a layer in
      the profile's group, which SWITCH_PROFILE sets. With no profile held
      the key does nothing. Studio puts it on a key with ZMK Studio's
      set_layer_binding, which needs the behavior metadata
      (ZMK_BEHAVIOR_METADATA); dt-bindings/minimalpad/profile_layer.h names
      the modes for a keymap.

config MINIMALPAD_MAC_ACTION
    bool "The &mac_action key, which sends ACTION_EVENT to Studio"
    depends on DT_HAS_MINIMALPAD_BEHAVIOR_MAC_ACTION_ENABLED
    default y
    help
      A key bound to &mac_action N does nothing on the pad. On the way down
      and on the way up it sends ACTION_EVENT with N to every host listening,
      and Minimalpad Studio does whatever it saved under that id, such as
      opening an app. Without Studio running the key is inert. The build
      advertises MP_CAP_MAC_ACTIONS in HELLO_ACK when this is on.

config MINIMALPAD_HOST_DIAL
    bool "A dial for each layer, set from Studio and kept on the pad"
    depends on DT_HAS_MINIMALPAD_BEHAVIOR_HOST_DIAL_ENABLED
    default y
    help
      A dial bound to &host_dial does what its layer's dial value says: tap a
      key, scroll, or step the underglow, with modifiers. Studio sets a
      layer's value with SET_DIAL and the pad keeps it in its settings;
      otherwise the keymap's clockwise and counter-clockwise values apply.
      The build advertises MP_CAP_LAYER_DIALS in HELLO_ACK when this is on.
      A scroll needs ZMK_POINTING for the pad's mouse report.

config MINIMALPAD_HOST_DIAL_SCROLL_STEP
    int "Wheel steps per step of the dial, for a scroll"
    depends on MINIMALPAD_HOST_DIAL
    range 1 20
    default 1
    help
      One step of the dial is one wheel click of an ordinary mouse at 1.

config MINIMALPAD_HOST_LIGHTING
    bool "The pad's own lighting, read and set from Studio"
    depends on ZMK_RGB_UNDERGLOW
    default y
    help
      GET_LIGHTING and SET_LIGHTING: Studio reads and changes the underglow
      the pad keeps as its own, on or off, colour, brightness, effect and
      speed, as its lighting keys and the dial do, and the pad sends
      LIGHTING_STATE when that changes. It also has the pad save a colour or
      brightness changed with its keys or the dial, which ZMK otherwise
      leaves until its next save of something else (ZMK issue #1920). The
      build advertises MP_CAP_LIGHTING in HELLO_ACK when this is on.

config MINIMALPAD_HOST_LIGHTS
    bool "Layer and key lights, kept on the pad and set from Studio"
    depends on ZMK_RGB_UNDERGLOW
    default y
    help
      SET_LAYER_LIGHT, GET_LAYER_LIGHT, SHOW_PAD_LIGHTING, SET_KEY_LIGHT and
      GET_KEY_LIGHTS: Studio gives a layer above Default a light, and a key
      on any layer, Default included, a light of its own: a colour, Off, or
      Inherit, which leaves the key to its layer and the layer to the one
      below. The pad keeps them in its settings, saved once changes have
      stopped for 2 seconds, so they last without Studio. While the pad's own
      lighting is being changed, from Studio or with a key or the dial, the
      pad shows it in their place. The build advertises layer and key lights
      in FEATURES when this is on. GET_FEATURES and MP_CAP_FEATURES do not
      depend on it: the host module answers them on every build.

config MINIMALPAD_HOST_LEDS_FORCE_SOLID
    bool "Show a host colour with the solid effect"
    depends on ZMK_RGB_UNDERGLOW
    default y
    help
      Solid is the only effect that reproduces a requested HSB exactly:
      breathe generates its own brightness, while spectrum and swirl
      generate hue. The effect that was in use before the host set a colour
      comes back on fallback.

module = MINIMALPAD_HOST
module-str = Minimalpad host module
source "subsys/logging/Kconfig.template.log_config"

endif # MINIMALPAD_HOST

config MINIMALPAD_LIGHT_LAYERS
    bool "Draw layer and key lights over the underglow"
    depends on DT_HAS_MINIMALPAD_LIGHT_LAYERS_ENABLED && ZMK_RGB_UNDERGLOW
    default y
    help
      Puts an LED strip between ZMK's underglow and the WS2812 chain. The
      underglow keeps drawing its effect, and this strip paints the light each
      key resolves to (mp_lights_resolve(), src/host/lights.c) over that frame:
      a colour at the underglow's current brightness, Off dark, and Inherit
      leaving the underglow's own pixel. While the underglow is off, or the pad
      is showing its own lighting, the frame passes through as it is.
      Without the host module's lights (MINIMALPAD_HOST_LIGHTS) every key
      resolves to Inherit, so the strip passes every frame through unchanged.
      The shield's devicetree makes this strip the underglow's, so switching
      it off needs the overlay's zmk,underglow pointed back at the chain.

config MINIMALPAD_STUDIO_BLE
    bool "ZMK Studio over Bluetooth, with the connection leak fixed"
    depends on ZMK_STUDIO_RPC && ZMK_BLE && !ZMK_STUDIO_TRANSPORT_BLE
    select RING_BUFFER
    select BT_USER_DATA_LEN_UPDATE
    default y
    help
      Takes the place of ZMK_STUDIO_TRANSPORT_BLE, which must be off. ZMK's
      transport leaks a reference to the host's connection on every answer
      longer than one packet, and after the host's next reconnect the pad sends
      it nothing until the pad restarts. src/studio/gatt_rpc_transport.c says
      how. The service is the same one, so nothing changes for a host.

config MINIMALPAD_STUDIO_BLE_PREF_LATENCY
    int "Latency to ask for while ZMK Studio is connected over Bluetooth"
    depends on MINIMALPAD_STUDIO_BLE
    default 10
    help
      ZMK_STUDIO_TRANSPORT_BLE_PREF_LATENCY under this build's name, with
      ZMK's default.

menuconfig MINIMALPAD_LEDS_IDLE_FADE
    bool "Fade the underglow out when the pad goes idle"
    depends on ZMK_RGB_UNDERGLOW && !ZMK_RGB_UNDERGLOW_AUTO_OFF_IDLE
    default y
    help
      Takes the place of ZMK_RGB_UNDERGLOW_AUTO_OFF_IDLE, which switches the
      underglow off the moment the pad goes idle. This dims it slowly first,
      then switches it off the same way, cutting the LEDs' power. A key or the
      dial brings it straight back. When the pad restarts while the underglow
      is off for idle, after deep sleep, a reset or a flat battery, the
      underglow comes back on, where ZMK's option leaves it off. The fade
      waits while Studio changes the lights, and after a change to them until
      ZMK has saved it, a minute after the change.

if MINIMALPAD_LEDS_IDLE_FADE

config MINIMALPAD_LEDS_IDLE_FADE_MS
    int "How long the fade takes, in milliseconds"
    range 0 30000
    default 8000
    help
      The fade starts when the pad goes idle, ZMK_IDLE_TIMEOUT after the last
      key press or dial turn. 0 switches the underglow off at once, as ZMK's
      own option does. The breathe effect sets its own brightness, so it does
      not dim and simply stops at the end.

module = MINIMALPAD_LEDS
module-str = Minimalpad LEDs
source "subsys/logging/Kconfig.template.log_config"

endif # MINIMALPAD_LEDS_IDLE_FADE
```

## dts/bindings/led_strip/minimalpad,light-layers.yaml
```yaml
# SPDX-License-Identifier: MIT

description: |
  An LED strip that sits between ZMK's underglow and the real LED chain. The
  underglow keeps drawing its effect; this strip paints layer and key lights
  over that frame before passing it on.

compatible: "minimalpad,light-layers"

properties:
  led-strip:
    type: phandle
    required: true
    description: The real LED chain the frames go to.

  chain-length:
    type: int
    required: true
    description: The number of LEDs, the same as the real chain's. ZMK's underglow reads it.

  key-positions:
    type: array
    required: true
    description: The key position each LED sits under, in chain order.
```
